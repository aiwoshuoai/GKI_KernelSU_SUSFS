## config/gki_defconfig
```kconfig
# 性能优化与调度策略
CONFIG_LTO_CLANG_THIN=y
# CONFIG_HZ_250 is not set
CONFIG_HZ_300=y
CONFIG_HZ=300
CONFIG_MQ_IOSCHED_DEADLINE=y
# 文件系统与SUSFS前置依赖
CONFIG_SHMEM=y
CONFIG_TMPFS_XATTR=y
CONFIG_TMPFS_POSIX_ACL=y
CONFIG_TMPFS_INODE64=y
CONFIG_MEMFD_CREATE=y
CONFIG_NTFS3_FS=y
CONFIG_NTFS3_LZX_XPRESS=y
CONFIG_NTFS3_FS_POSIX_ACL=y
CONFIG_QUOTACTL=y
# BPF核心框架与高级追踪
CONFIG_BPF=y
CONFIG_HAVE_EBPF_JIT=y
CONFIG_BPF_EVENTS=y
CONFIG_DEBUG_INFO_BTF_MODULES=y
CONFIG_KPROBE_EVENTS=y
CONFIG_UPROBES=y
CONFIG_UPROBE_EVENTS=y
CONFIG_TRACEPOINTS=y
CONFIG_FTRACE=y
CONFIG_BPF_UNPRIV_DEFAULT_OFF=y
CONFIG_BPF_STREAM_PARSER=y
# TCP拥塞控制与QoS队列调度
CONFIG_TCP_CONG_ADVANCED=y
CONFIG_TCP_CONG_BBR=y
CONFIG_TCP_CONG_CUBIC=y
CONFIG_TCP_CONG_WESTWOOD=y
CONFIG_TCP_CONG_HTCP=y
# CONFIG_TCP_CONG_BIC is not set
CONFIG_DEFAULT_BBR=y
CONFIG_NET_SCH_CAKE=y

CONFIG_NETFILTER_XT_MATCH_MARK=y
CONFIG_NETFILTER_XT_TARGET_MARK=y
CONFIG_NETFILTER_XT_MATCH_SOCKET=y
CONFIG_NETFILTER_XT_MATCH_CGROUP=y
CONFIG_NETFILTER_XT_MATCH_OWNER=y
CONFIG_IP_NF_MATCH_RPFILTER=yCONFIG_NETFILTER_XT_SET=y
CONFIG_IP_SET=y
CONFIG_IP_SET_MAX=65534
CONFIG_IP_SET_HASH_IP=y
CONFIG_IP_SET_HASH_NET=y
```
